## drivers/voltage_divider/Kconfig
```kconfig
# Copyright (c) 2021 Nordic Semiconductor ASA
# SPDX-License-Identifier: Apache-2.0

menuconfig VOLTAGE_DIVIDER
	bool "voltage divider sampling driver"
    default y
    depends on DT_HAS_IRNAS_VOLTAGE_DIVIDER_ENABLED
	depends on ADC
	help
	  Enable voltage divider driver

if VOLTAGE_DIVIDER

config VOLTAGE_DIVIDER_SHELL
	bool "Enable shell commands for voltage divider"
	depends on SHELL


module = VOLTAGE_DIVIDER
module-str = Voltage divider
source "subsys/logging/Kconfig.template.log_config"

endif # VOLTAGE_DIVIDER
```

## dts/bindings/irnas,voltage-divider.yaml
```yaml
description: |
  Voltage divider device. Capable of measuring input voltage through voltage
  divider or directly. Optionaly it can also directly measure Vdd voltage of
  the chip.
  To measure input voltage through voltage divider:
    - only set upper-resistor-ohms and lower-resistor-ohms properties to
      resistor values.
  To measure input voltage directly:
    - only set upper-resistor-ohms and lower-resistor-ohms properties to 0
  To measure internal voltage:
    - only set measure-internal-vdd property

  Optionally, in the first two cases, if power needs to be applied so that
  voltage-divider is powered the power-gpios property needs to be set.

compatible: "irnas,voltage-divider"

include: base.yaml

properties:
  io-channels:
    required: true
    description: |
      Adc instance and channel number. Channel number is directly connected with
      the analog pin number (eg. 3 is AIN3). Channel number is ignored, if
      property measure-internal-vdd is set to true.

  upper-resistor-ohms:
    type: int
    required: false
    description: |
      Resistance of the upper resistor of the voltage divider in ohms.

  lower-resistor-ohms:
    type: int
    required: false
    description: |
      Resistance of the lower resistor of the voltage divider in ohms.

  measure-internal-vdd:
    type: boolean
    required: false
    description: |
      If present, the internal supply voltage is measured.

  power-gpios:
    type: phandle-array
    required: false
    description: |
      Enable power to the voltage divider inputs.

      If present, the corresponding GPIO is set to an active level, adc
      measurement is taken and GPIO is set back to inactive level.

  power-startup-delay-ms:
    type: int
    default: 10
    required: false
    description: |
      Amount of time to wait in milliseconds after enabling power-gpio. 
      Needed to stabilize power to voltage divider input, before continuing with sampling.
```
