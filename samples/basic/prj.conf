## CMakeLists.txt
```
# SPDX-License-Identifier: Apache-2.0

cmake_minimum_required(VERSION 3.13.1)
find_package(Zephyr HINTS $ENV{ZEPHYR_BASE})

project(voltage_divider_basic_sample)

zephyr_compile_options(-fdiagnostics-color=always)
set(CMAKE_EXPORT_COMPILE_COMMANDS ON)
set(CMAKE_BUILD_TYPE Debug)

target_sources(app PRIVATE src/main.c)
```

## prj.conf
```kconfig
# log
CONFIG_LOG=y
CONFIG_LOG_MODE_IMMEDIATE=y
CONFIG_LOG_BACKEND_UART=y


# Voltage divider depends on this
CONFIG_ADC=y
```

## app.overlay
```dts
/ {
    vbatt {
        compatible = "irnas,voltage-divider";
        io-channels = <&adc 1>;
        upper-resistor-ohms = <1000>;
        lower-resistor-ohms = <1000>;
        power-startup-delay-ms = <20>;
        status = "okay";
    };
};
```

## src/main.c
```c
#include <device.h>
#include <devicetree.h>
#include <logging/log.h>
#include <voltage_divider.h>
#include <zephyr.h>

LOG_MODULE_REGISTER(main);

#define VOLTAGE_DIVIDER_DEV "VBAT"

void main(void)
{
	LOG_INF("Voltage divider test running on: %s", CONFIG_BOARD);

	const struct device *dev;
	int err;

	// get device binding
	dev = device_get_binding(VOLTAGE_DIVIDER_DEV);
	if (dev == NULL) {
		LOG_ERR("Device unknown (%s)", VOLTAGE_DIVIDER_DEV);
		return;
	}

	// take a sample
	while (1) {

		err = voltage_divider_sample(dev);
		if (err < 0) {
			LOG_ERR("voltage_divider_sample, err: %d", err);
		} else {
			LOG_INF("Voltage divider sample valeue: %d", err);
		}

		k_sleep(K_SECONDS(3));
	}
}
```
