## CMakeLists.txt
```
# SPDX-License-Identifier: Apache-2.0

cmake_minimum_required(VERSION 3.13.1)
find_package(Zephyr HINTS $ENV{ZEPHYR_BASE})

project(voltage_divider_test)

zephyr_compile_options(-fdiagnostics-color=always)
set(CMAKE_EXPORT_COMPILE_COMMANDS ON)
set(CMAKE_BUILD_TYPE Debug)

zephyr_include_directories(.)
zephyr_include_directories(src)

FILE(GLOB app_sources src/*.c)

target_sources(app PRIVATE ${app_sources})
```

## prj.conf
```kconfig
CONFIG_NEWLIB_LIBC=y
CONFIG_NEWLIB_LIBC_FLOAT_PRINTF=y

# stack
CONFIG_MAIN_STACK_SIZE=4096

# log
CONFIG_LOG=y
CONFIG_LOG_MODE_IMMEDIATE=y
# log via UART
CONFIG_LOG_BACKEND_UART=y

# reboot
CONFIG_REBOOT=y

# power management
CONFIG_PM=y
CONFIG_PM_DEVICE=y
CONFIG_PM_DEVICE_RUNTIME=y

# voltage divider
CONFIG_ADC=y
CONFIG_VOLTAGE_DIVIDER=y

# Shell configuration
#CONFIG_SHELL=y
# shell over UART
#CONFIG_SHELL_BACKEND_SERIAL=y
# shell features
#CONFIG_SHELL_TAB=y
#CONFIG_SHELL_TAB_AUTOCOMPLETION=y
#CONFIG_SHELL_HISTORY=y
#CONFIG_SHELL_WILDCARD=n
#CONFIG_SHELL_STATS=y
#CONFIG_SHELL_CMDS=y
#CONFIG_SHELL_METAKEYS=n
# existing shells in zephyr
#CONFIG_VOLTAGE_DIVIDER_SHELL=y
```

## src/main.c
```c
#include <zephyr.h>
#include <device.h>
#include <devicetree.h>
#include <logging/log.h>

#include <voltage_divider.h> 


LOG_MODULE_REGISTER(main);

#define VOLTAGE_DIVIDER_DEV "VBAT"

void main(void)
{
	LOG_INF("Voltage divider test running on: %s", CONFIG_BOARD);
	
	const struct device *dev;
	int err;

	// get device binding
	dev = device_get_binding(VOLTAGE_DIVIDER_DEV);
	if (dev == NULL) {
		LOG_ERR("Device unknown (%s)", VOLTAGE_DIVIDER_DEV);
		return;
	}

	// take a sample
	err = voltage_divider_sample(dev);
	if (err < 0) {
		LOG_ERR("voltage_divider_sample, err: %d", err);
	}
	else
	{
		LOG_INF("Voltage divider sample valeue: %d", err);
	}
}
```
